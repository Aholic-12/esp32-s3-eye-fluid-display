#include <stdio.h>
#include <stdlib.h>
#include <string.h>

#include "driver/gpio.h"
#include "driver/spi_master.h"
#include "esp_err.h"
#include "esp_heap_caps.h"
#include "esp_lcd_panel_io.h"
#include "esp_lcd_panel_ops.h"
#include "esp_lcd_panel_vendor.h"
#include "esp_log.h"
#include "freertos/FreeRTOS.h"
#include "freertos/task.h"

#include "lcd_driver.h"

static const char *TAG = "lcd_driver";

#define LCD_PIN_NUM_DC          43
#define LCD_PIN_NUM_CS          44
#define LCD_PIN_NUM_CLK         21
#define LCD_PIN_NUM_DATA        47
#define LCD_PIN_NUM_BK_LIGHT    48
#define LCD_PIN_NUM_RST         (-1)

#define LCD_SPI_HOST            SPI3_HOST
#define LCD_SPI_FREQ_HZ         (40 * 1000 * 1000)
#define LCD_MAX_TRANSFER_SZ     (LCD_WIDTH * 40 * sizeof(uint16_t))

typedef struct {
    esp_lcd_panel_handle_t panel;
    esp_lcd_panel_io_handle_t panel_io;
    uint16_t *framebuffers[2];
    uint16_t *draw_buffer;
    uint8_t draw_index;
} lcd_t;

static lcd_t s_lcd;

static const uint8_t font_8x16[95][16] = {
    {0x00,0x00,0x00,0x00,0x00,0x00,0x00,0x00,0x00,0x00,0x00,0x00,0x00,0x00,0x00,0x00},
    {0x00,0x00,0x00,0x00,0x00,0x00,0x18,0x18,0x18,0x18,0x00,0x00,0x00,0x18,0x00,0x00},
    {0x00,0x00,0x00,0x00,0x36,0x36,0x00,0x00,0x00,0x00,0x00,0x00,0x00,0x00,0x00,0x00},
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    {0x00,0x00,0x00,0x00,0x00,0x00,0x00,0x00,0x00,0x00,0x00,0x00,0x00,0x00,0x00,0x00},
};

static void lcd_backlight_init(void)
{
    const gpio_config_t bk_cfg = {
        .pin_bit_mask = 1ULL << LCD_PIN_NUM_BK_LIGHT,
        .mode = GPIO_MODE_OUTPUT,
        .pull_up_en = GPIO_PULLUP_DISABLE,
        .pull_down_en = GPIO_PULLDOWN_DISABLE,
        .intr_type = GPIO_INTR_DISABLE,
    };
    gpio_config(&bk_cfg);
    gpio_set_level(LCD_PIN_NUM_BK_LIGHT, 0);
}

static void lcd_backlight_set(bool on)
{
    gpio_set_level(LCD_PIN_NUM_BK_LIGHT, on ? 1 : 0);
}

static void lcd_draw_char(lcd_handle_t lcd, int x, int y, char ch, uint16_t color, int scale)
{
    lcd_t *handle = (lcd_t *)lcd;
    if (handle == NULL || ch < 32 || ch > 126) {
        return;
    }

    if (scale < 1) {
        scale = 1;
    }

    const uint8_t *font = font_8x16[ch - 32];
    for (int row = 0; row < 16; row++) {
        for (int col = 0; col < 8; col++) {
            if ((font[row] & (1U << (7 - col))) == 0) {
                continue;
            }
            const int px = x + col * scale;
            const int py = y + row * scale;
            for (int dy = 0; dy < scale; dy++) {
                for (int dx = 0; dx < scale; dx++) {
                    lcd_draw_pixel(lcd, px + dx, py + dy, color);
                }
            }
        }
    }
}

lcd_handle_t lcd_init(void)
{
    esp_err_t ret;
    memset(&s_lcd, 0, sizeof(s_lcd));

    lcd_backlight_init();

    const spi_bus_config_t bus_cfg = {
        .mosi_io_num = LCD_PIN_NUM_DATA,
        .miso_io_num = -1,
        .sclk_io_num = LCD_PIN_NUM_CLK,
        .quadwp_io_num = -1,
        .quadhd_io_num = -1,
        .max_transfer_sz = LCD_MAX_TRANSFER_SZ,
    };

    ret = spi_bus_initialize(LCD_SPI_HOST, &bus_cfg, SPI_DMA_CH_AUTO);
    if (ret != ESP_OK && ret != ESP_ERR_INVALID_STATE) {
        ESP_LOGE(TAG, "spi bus init failed: %s", esp_err_to_name(ret));
        return NULL;
    }

    const esp_lcd_panel_io_spi_config_t io_config = {
        .dc_gpio_num = LCD_PIN_NUM_DC,
        .cs_gpio_num = LCD_PIN_NUM_CS,
        .pclk_hz = LCD_SPI_FREQ_HZ,
        .lcd_cmd_bits = 8,
        .lcd_param_bits = 8,
        .spi_mode = 0,
        .trans_queue_depth = 10,
    };

    ret = esp_lcd_new_panel_io_spi(LCD_SPI_HOST, &io_config, &s_lcd.panel_io);
    if (ret != ESP_OK) {
        ESP_LOGE(TAG, "panel io init failed: %s", esp_err_to_name(ret));
        return NULL;
    }

    const esp_lcd_panel_dev_config_t panel_config = {
        .reset_gpio_num = LCD_PIN_NUM_RST,
        .rgb_ele_order = LCD_RGB_ELEMENT_ORDER_RGB,
        .bits_per_pixel = 16,
    };

    ret = esp_lcd_new_panel_st7789(s_lcd.panel_io, &panel_config, &s_lcd.panel);
    if (ret != ESP_OK) {
        ESP_LOGE(TAG, "panel init failed: %s", esp_err_to_name(ret));
        return NULL;
    }

    ESP_ERROR_CHECK(esp_lcd_panel_reset(s_lcd.panel));
    ESP_ERROR_CHECK(esp_lcd_panel_init(s_lcd.panel));
    ESP_ERROR_CHECK(esp_lcd_panel_invert_color(s_lcd.panel, true));
    ESP_ERROR_CHECK(esp_lcd_panel_swap_xy(s_lcd.panel, false));
    ESP_ERROR_CHECK(esp_lcd_panel_mirror(s_lcd.panel, false, false));
    ESP_ERROR_CHECK(esp_lcd_panel_disp_on_off(s_lcd.panel, true));

    for (int i = 0; i < 2; i++) {
        s_lcd.framebuffers[i] = (uint16_t *)heap_caps_malloc(LCD_WIDTH * LCD_HEIGHT * sizeof(uint16_t), MALLOC_CAP_DMA | MALLOC_CAP_8BIT);
        if (s_lcd.framebuffers[i] == NULL) {
            ESP_LOGE(TAG, "framebuffer[%d] alloc failed", i);
            return NULL;
        }
        memset(s_lcd.framebuffers[i], 0, LCD_WIDTH * LCD_HEIGHT * sizeof(uint16_t));
    }
    s_lcd.draw_index = 0;
    s_lcd.draw_buffer = s_lcd.framebuffers[s_lcd.draw_index];

    lcd_backlight_set(true);
    ESP_LOGI(TAG, "lcd init ok (%dx%d)", LCD_WIDTH, LCD_HEIGHT);
    return &s_lcd;
}

void lcd_clear(lcd_handle_t lcd, uint16_t color)
{
    lcd_t *handle = (lcd_t *)lcd;
    if (handle == NULL || handle->draw_buffer == NULL) {
        return;
    }

    for (int i = 0; i < LCD_WIDTH * LCD_HEIGHT; i++) {
        handle->draw_buffer[i] = color;
    }
}

void lcd_set_window(lcd_handle_t lcd, int x, int y, int width, int height)
{
    (void)lcd;
    (void)x;
    (void)y;
    (void)width;
    (void)height;
}

void lcd_draw_pixel(lcd_handle_t lcd, int x, int y, uint16_t color)
{
    lcd_t *handle = (lcd_t *)lcd;
    if (handle == NULL || handle->draw_buffer == NULL) {
        return;
    }
    if (x < 0 || x >= LCD_WIDTH || y < 0 || y >= LCD_HEIGHT) {
        return;
    }
    handle->draw_buffer[y * LCD_WIDTH + x] = color;
}

void lcd_draw_hline(lcd_handle_t lcd, int x, int y, int width, uint16_t color)
{
    if (width <= 0 || y < 0 || y >= LCD_HEIGHT) {
        return;
    }
    if (x < 0) {
        width += x;
        x = 0;
    }
    if (x + width > LCD_WIDTH) {
        width = LCD_WIDTH - x;
    }
    for (int i = 0; i < width; i++) {
        lcd_draw_pixel(lcd, x + i, y, color);
    }
}

void lcd_draw_vline(lcd_handle_t lcd, int x, int y, int height, uint16_t color)
{
    if (height <= 0 || x < 0 || x >= LCD_WIDTH) {
        return;
    }
    if (y < 0) {
        height += y;
        y = 0;
    }
    if (y + height > LCD_HEIGHT) {
        height = LCD_HEIGHT - y;
    }
    for (int i = 0; i < height; i++) {
        lcd_draw_pixel(lcd, x, y + i, color);
    }
}

void lcd_draw_line(lcd_handle_t lcd, int x0, int y0, int x1, int y1, uint16_t color)
{
    const int dx = abs(x1 - x0);
    const int sx = x0 < x1 ? 1 : -1;
    const int dy = -abs(y1 - y0);
    const int sy = y0 < y1 ? 1 : -1;
    int err = dx + dy;

    while (true) {
        lcd_draw_pixel(lcd, x0, y0, color);
        if (x0 == x1 && y0 == y1) {
            break;
        }
        const int e2 = err * 2;
        if (e2 >= dy) {
            err += dy;
            x0 += sx;
        }
        if (e2 <= dx) {
            err += dx;
            y0 += sy;
        }
    }
}

void lcd_draw_rect(lcd_handle_t lcd, int x, int y, int width, int height, uint16_t color)
{
    lcd_draw_hline(lcd, x, y, width, color);
    lcd_draw_hline(lcd, x, y + height - 1, width, color);
    lcd_draw_vline(lcd, x, y, height, color);
    lcd_draw_vline(lcd, x + width - 1, y, height, color);
}

void lcd_fill_rect(lcd_handle_t lcd, int x, int y, int width, int height, uint16_t color)
{
    if (width <= 0 || height <= 0) {
        return;
    }
    for (int row = 0; row < height; row++) {
        lcd_draw_hline(lcd, x, y + row, width, color);
    }
}

void lcd_draw_string(lcd_handle_t lcd, int x, int y, const char *str, uint16_t color, int scale)
{
    if (str == NULL) {
        return;
    }

    int cursor_x = x;
    while (*str != '\0') {
        lcd_draw_char(lcd, cursor_x, y, *str, color, scale);
        cursor_x += 8 * (scale < 1 ? 1 : scale);
        str++;
    }
}

void lcd_draw_circle(lcd_handle_t lcd, int cx, int cy, int radius, uint16_t color)
{
    int x = radius;
    int y = 0;
    int error = 1 - x;

    while (x >= y) {
        lcd_draw_pixel(lcd, cx + x, cy + y, color);
        lcd_draw_pixel(lcd, cx + y, cy + x, color);
        lcd_draw_pixel(lcd, cx - y, cy + x, color);
        lcd_draw_pixel(lcd, cx - x, cy + y, color);
        lcd_draw_pixel(lcd, cx - x, cy - y, color);
        lcd_draw_pixel(lcd, cx - y, cy - x, color);
        lcd_draw_pixel(lcd, cx + y, cy - x, color);
        lcd_draw_pixel(lcd, cx + x, cy - y, color);
        y++;
        if (error < 0) {
            error += 2 * y + 1;
        } else {
            x--;
            error += 2 * (y - x) + 1;
        }
    }
}

void lcd_fill_circle(lcd_handle_t lcd, int cx, int cy, int radius, uint16_t color)
{
    int x = radius;
    int y = 0;
    int error = 1 - x;

    while (x >= y) {
        lcd_draw_hline(lcd, cx - x, cy + y, 2 * x + 1, color);
        lcd_draw_hline(lcd, cx - x, cy - y, 2 * x + 1, color);
        lcd_draw_hline(lcd, cx - y, cy + x, 2 * y + 1, color);
        lcd_draw_hline(lcd, cx - y, cy - x, 2 * y + 1, color);
        y++;
        if (error < 0) {
            error += 2 * y + 1;
        } else {
            x--;
            error += 2 * (y - x) + 1;
        }
    }
}

void lcd_swap_buffers(lcd_handle_t lcd)
{
    lcd_t *handle = (lcd_t *)lcd;
    if (handle == NULL || handle->draw_buffer == NULL) {
        return;
    }

    uint16_t *flush_buffer = handle->draw_buffer;
    if (esp_lcd_panel_draw_bitmap(handle->panel, 0, 0, LCD_WIDTH, LCD_HEIGHT, flush_buffer) != ESP_OK) {
        ESP_LOGE(TAG, "panel draw bitmap failed");
        return;
    }

    handle->draw_index ^= 1;
    handle->draw_buffer = handle->framebuffers[handle->draw_index];
}

int lcd_get_width(void)
{
    return LCD_WIDTH;
}

int lcd_get_height(void)
{
    return LCD_HEIGHT;
}

void lcd_deinit(lcd_handle_t lcd)
{
    lcd_t *handle = (lcd_t *)lcd;
    if (handle == NULL) {
        return;
    }

    lcd_backlight_set(false);

    for (int i = 0; i < 2; i++) {
        if (handle->framebuffers[i] != NULL) {
            heap_caps_free(handle->framebuffers[i]);
            handle->framebuffers[i] = NULL;
        }
    }
    handle->draw_buffer = NULL;
    if (handle->panel != NULL) {
        esp_lcd_panel_del(handle->panel);
        handle->panel = NULL;
    }
    if (handle->panel_io != NULL) {
        esp_lcd_panel_io_del(handle->panel_io);
        handle->panel_io = NULL;
    }
    spi_bus_free(LCD_SPI_HOST);
}
